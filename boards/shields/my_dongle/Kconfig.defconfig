## boards/shields/my_dongle/Kconfig.defconfig
```kconfig
if SHIELD_MY_DONGLE

config ZMK_KEYBOARD_NAME
    default "Lily58"

config ZMK_SPLIT_ROLE_CENTRAL
    default y

config ZMK_SPLIT
    default y

config ZMK_SPLIT_BLE_CENTRAL_PERIPHERALS
    default 2

config BT_MAX_CONN
    default 5

config BT_MAX_PAIRED
    default 5    
endif
```
